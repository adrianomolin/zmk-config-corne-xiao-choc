## boards/shields/chippy/Kconfig.defconfig
```kconfig
if SHIELD_CHIPPY_LEFT

config ZMK_KEYBOARD_NAME
	default "Chippy"

config ZMK_SPLIT_BLE_ROLE_CENTRAL
	default y

endif

if SHIELD_CHIPPY_RIGHT

config ZMK_KEYBOARD_NAME
	default "Chippy Right"
	
endif

if SHIELD_CHIPPY_LEFT || SHIELD_CHIPPY_RIGHT

config ZMK_SPLIT
	default y
 
if ZMK_DISPLAY

config SPI
	default y

config LS0XX
	default y

config LV_Z_BITS_PER_PIXEL
	default 1

choice LV_COLOR_DEPTH
	default LV_COLOR_DEPTH_1

endchoice

config LV_DPI_DEF
	default 30

config LV_Z_VDB_SIZE
	default 16

endif # ZMK_DISPLAY

endif
```

## boards/shields/chippy/Kconfig.shield
```kconfig
config SHIELD_CHIPPY_LEFT
	def_bool $(shields_list_contains,chippy_left)

config SHIELD_CHIPPY_RIGHT
	def_bool $(shields_list_contains,chippy_right)
```
